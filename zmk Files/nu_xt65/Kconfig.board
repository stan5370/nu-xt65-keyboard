## zmk Files/nu_xt65/Kconfig.board
```kconfig
if SOC_NRF5340_CPUAPP_QKAA

config BOARD_NU_XT65_CPUAPP
	bool "NU XT65 nRF5340 Application MCU"

config BOARD_NU_XT65_CPUAPP_NS
	bool "NU XT65 nRF5340 Application MCU non-secure"

endif # SOC_NRF5340_CPUAPP_QKAA

config BOARD_NU_XT65_CPUNET
	bool "NU XT65 nRF5340 Network MCU"
	depends on SOC_NRF5340_CPUNET_QKAA
```

## zmk Files/nu_xt65/Kconfig.defconfig
```kconfig
if BOARD_NU_XT65_CPUAPP || BOARD_NU_XT65_CPUAPP_NS

config BOARD
    default "nu_xt65" if BOARD_NU_XT65_CPUAPP || BOARD_NU_XT65_CPUAPP_NS

# By default, if we build for a Non-Secure version of the board,
# enable building with TF-M as the Secure Execution Environment.
config BUILD_WITH_TFM
	default y if BOARD_NRF5340DK_NRF5340_CPUAPP_NS

if BUILD_WITH_TFM

# By default, if we build with TF-M, instruct build system to
# flash the combined TF-M (Secure) & Zephyr (Non Secure) image
config TFM_FLASH_MERGED_BINARY
	bool
	default y

endif # BUILD_WITH_TFM

DT_CHOSEN_Z_CODE_PARTITION := zephyr,code-partition
DT_CHOSEN_Z_SRAM_PARTITION := zephyr,sram-secure-partition

if BOARD_NU_XT65_CPUAPP && TRUSTED_EXECUTION_SECURE

config FLASH_LOAD_SIZE
	default $(dt_chosen_reg_size_hex,$(DT_CHOSEN_Z_CODE_PARTITION))

config SRAM_SIZE
	default $(dt_chosen_reg_size_int,$(DT_CHOSEN_Z_SRAM_PARTITION),0,K)

endif # BOARD_NU_XT65_CPUAPP && TRUSTED_EXECUTION_SECURE

if BOARD_NU_XT65_CPUAPP_NS

config FLASH_LOAD_OFFSET
	default $(dt_chosen_reg_addr_hex,$(DT_CHOSEN_Z_CODE_PARTITION))

config FLASH_LOAD_SIZE
	default $(dt_chosen_reg_size_hex,$(DT_CHOSEN_Z_CODE_PARTITION))

endif # BOARD_NU_XT65_CPUAPP_NS

endif # BOARD_NU_XT65_CPUAPP || BOARD_NU_XT65_CPUAPP_NS

config BOARD
	default "nrf5340dk_nrf5340_cpunet" if BOARD_NRF5340DK_NRF5340_CPUNET

config MBOX_NRFX_IPC
	default MBOX

if BOARD_NU_XT65_CPUAPP || BOARD_NU_XT65_CPUAPP_NS

choice BT_HCI_BUS_TYPE
	default BT_RPMSG if BT
endchoice

config HEAP_MEM_POOL_SIZE
	default 4096 if BT_RPMSG

if USB

config USB_NRFX
    default y

config USB_DEVICE_STACK
    default y

endif # USB

config ZMK_KEYBOARD_NAME
    default "NU XT65"

endif #  BOARD_NU_XT65_CPUAPP || BOARD_NU_XT65_CPUAPP_NS


if BOARD_NU_XT65_CPUNET

config BT_CTLR
    default BT

endif # BOARD_NU_XT65_CPUNET
```
